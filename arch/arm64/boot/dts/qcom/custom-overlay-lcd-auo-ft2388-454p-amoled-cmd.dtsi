/* Copyright (c) 2013, The Linux Foundation. All rights reserved.
 *
 * This program is free software; you can redistribute it and/or modify
 * it under the terms of the GNU General Public License version 2 and
 * only version 2 as published by the Free Software Foundation.
 *
 * This program is distributed in the hope that it will be useful,
 * but WITHOUT ANY WARRANTY; without even the implied warranty of
 * MERCHANTABILITY or FITNESS FOR A PARTICULAR PURPOSE.  See the
 * GNU General Public License for more details.
 */

/*---------------------------------------------------------------------------
 * This file is autogenerated file using gcdb parser. Please do not edit it.
 * Update input XML file to add a new entry or update variable in this file
 * VERSION = "1.0"
 *---------------------------------------------------------------------------*/
&mdss_mdp {
	dsi_auo_ft2388_454p_amoled_cmd: qcom,mdss_dsi_auo_ft2388_454p_amoled_cmd {
		qcom,mdss-dsi-panel-name = "auo ft2388 454p command mode dsi panel";
		qcom,mdss-dsi-panel-controller = <&mdss_dsi0>;
		qcom,mdss-dsi-panel-type = "dsi_cmd_mode";
		qcom,mdss-dsi-panel-destination = "display_1";
		qcom,mdss-dsi-panel-framerate = <45>;
		qcom,mdss-dsi-virtual-channel-id = <0>;
		qcom,mdss-dsi-stream = <0>;
		qcom,mdss-dsi-panel-width = <454>;
		qcom,mdss-dsi-panel-height = <454>;
		qcom,mdss-dsi-h-front-porch = <16>;
		qcom,mdss-dsi-h-back-porch = <20>;
		qcom,mdss-dsi-h-pulse-width = <4>;
		qcom,mdss-dsi-h-sync-skew = <0>;
		qcom,mdss-dsi-v-back-porch = <20>;
		qcom,mdss-dsi-v-front-porch = <20>;
		qcom,mdss-dsi-v-pulse-width = <2>;
		qcom,mdss-dsi-h-left-border = <0>;
		qcom,mdss-dsi-h-right-border = <0>;
		qcom,mdss-dsi-v-top-border = <0>;
		qcom,mdss-dsi-v-bottom-border = <0>;
		qcom,mdss-dsi-bpp = <24>;
		qcom,mdss-dsi-color-order = "rgb_swap_rgb";
		qcom,mdss-dsi-underflow-color = <0xff>;
		qcom,mdss-dsi-border-color = <0>;
		qcom,mdss-dsi-pixel-packing = "tight";
		qcom,mdss-dsi-pixel-alignment = <0>;
		qcom,mdss-dsi-on-command = [
			15 01 00 00 00 00 02 35 00
			39 01 00 00 00 00 05 2A 00 00 01 C6
			39 01 00 00 00 00 05 2B 00 00 01 C6
			15 01 00 00 0F 00 02 11 00
			23 01 00 00 00 00 02 00 00
			29 01 00 00 00 00 04 FF 23 88 01
			23 01 00 00 00 00 02 00 80
			29 01 00 00 00 00 03 FF 23 88

			23 01 00 00 00 00 02 51 00
			23 01 00 00 00 00 02 00 02
			23 01 00 00 00 00 02 C6 80 //idle gamma

			23 01 00 00 00 00 02 00 80
			29 01 00 00 41 00 03 B4 80 F1
			23 01 00 00 00 00 02 00 80
			29 01 00 00 00 00 03 B4 00 00
			23 01 00 00 00 00 02 00 80
			29 01 00 00 00 00 03 FF 00 00
			23 01 00 00 00 00 02 00 00
			29 01 00 00 40 00 04 FF 00 00 00
			15 01 00 00 78 00 02 11 00
			15 01 00 00 64 00 02 29 00];
		qcom,mdss-dsi-off-command = [
			15 01 00 00 00 00 02 28 00
			15 01 00 00 78 00 02 10 00];
		qcom,mdss-dsi-on-command-state = "dsi_lp_mode";
		qcom,mdss-dsi-off-command-state = "dsi_lp_mode";
		qcom,mdss-dsi-idle-on-command = [
			15 01 00 00 00 00 02 39 00
			23 01 00 00 00 00 02 00 00
			29 01 00 00 00 00 04 FF 23 88 01
			23 01 00 00 00 00 02 00 80
			29 01 00 00 00 00 03 FF 23 88
			23 01 00 00 00 00 02 00 80
			23 01 00 00 00 00 02 C4 60

			23 01 00 00 00 00 02 00 00
			23 01 00 00 00 00 02 C6 46 //idle brightness

			23 01 00 00 00 00 02 00 80
			29 01 00 00 00 00 03 FF 00 00
			23 01 00 00 00 00 02 00 00
			29 01 00 00 00 00 03 FF 00 00];
		qcom,mdss-dsi-idle-on-command-state = "dsi_lp_mode";
		qcom,mdss-dsi-idle-off-command = [
			23 01 00 00 00 00 02 00 00
			29 01 00 00 00 00 04 FF 23 88 01
			23 01 00 00 00 00 02 00 80
			29 01 00 00 00 00 03 FF 23 88
			23 01 00 00 00 00 02 00 80
			23 01 00 00 00 00 02 C4 C0

			23 01 00 00 00 00 02 00 80
			29 01 00 00 00 00 03 FF 00 00
			23 01 00 00 00 00 02 00 00
			29 01 00 00 00 00 04 FF 00 00 00
			15 01 00 00 00 00 02 38 00];/* Idle-Mode Off */
		qcom,mdss-dsi-idle-off-command-state = "dsi_lp_mode";

		qcom,mdss-dsi-h-sync-pulse = <1>;
		qcom,mdss-dsi-traffic-mode = "burst_mode";
		qcom,mdss-dsi-lane-map = "lane_map_0123";
		qcom,mdss-dsi-bllp-eof-power-mode;
		qcom,mdss-dsi-bllp-power-mode;
		qcom,mdss-dsi-lane-0-state;
		qcom,mdss-tear-check-frame-rate = <4500>;
		qcom,mdss-dsi-idle-fps = <15>;
		/* clk = totlaH * totalV * bpp* 60fps */
		qcom,mdss-dsi-panel-clockrate = <308655360>;
		qcom,mdss-dsi-te-pin-select = <1>;
		qcom,mdss-dsi-te-dcs-command = <1>;
		qcom,mdss-dsi-te-check-enable;
		qcom,mdss-dsi-te-using-te-pin;
		//qcom,mdss-dsi-panel-timings = [4D 0C 08 00 2C 30 0C 10 0B 03 04 00];
		qcom,mdss-dsi-t-clk-post = <0x08>;
		qcom,mdss-dsi-t-clk-pre = <0x24>;
		qcom,mdss-dsi-bl-min-level = <1>;
		qcom,mdss-dsi-bl-max-level = <255>;
		qcom,mdss-dsi-dma-trigger = "trigger_sw";
		qcom,mdss-dsi-mdp-trigger = "none";
		qcom,mdss-dsi-bl-pmic-control-type = "bl_ctrl_dcs";
		qcom,mdss-dsi-reset-sequence = <1 20>, <0 20>, <1 20>;
	};
};

