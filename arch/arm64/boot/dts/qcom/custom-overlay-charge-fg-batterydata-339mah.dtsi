
qcom,4948856_lc_b840_339mah_pmw3100_averaged_masterslave_dec1th2020 {
	qcom, = <24>;
	/* #4948856_LC_B840_339mAH_PMW3100_averaged_MasterSlave_Dec1th2020*/
	qcom,max-voltage-uv = <4450000>;
	qcom,fastchg-current-ma = <325>;
	qcom,fg-cc-cv-threshold-mv = <4440>;
	qcom,nom-batt-capacity-mah = <339>;
	qcom,batt-id-kohm = <100>;
	qcom,battery-beta = <4250>;
	qcom,battery-type = "4948856_lc_b840_339mah_pmw3100_averaged_masterslave_dec1th2020";
	qcom,checksum = <0x2957>;
	qcom,gui-version = "PM660GUI - 0.0.0.45";
	qcom,jeita-fcc-ranges = <0   100  75000
				101 200  100000
				201 450  325000
				451 550  150000>;
	qcom,jeita-fv-ranges = <0   100  4450000
				101 200  4450000
				201 450  4450000
				451 530  4100000>;
	qcom,step-chg-ranges = <3500000  4400000  325000
			4400001  4450000  150000>;
	qcom,fg-profile-data = [
		 E2 24 F0 15
		 6F 13 18 0D
		 01 1D 61 01
		 09 FC BA 02
		 FD 18 62 22
		 7E 3C 8F 4B
		 9D 00 00 00
		 15 00 00 00
		 00 00 D0 CD
		 4A BD 68 C3
		 3F 00 08 00
		 5F EB 5E 07
		 3A EC 43 DC
		 D1 DD E5 F3
		 F5 24 C8 53
		 0C 06 09 20
		 27 00 14 00
		 1E 21 D3 0D
		 2C 12 48 04
		 E5 1C 92 02
		 C4 0C AB 0B
		 AD 18 6E 23
		 9B 44 54 5A
		 75 00 00 00
		 0F 00 00 00
		 00 00 74 CD
		 83 BA CD BD
		 3B 00 00 00
		 63 F3 5E 07
		 99 07 0A E5
		 A8 D3 2F F2
		 3B ED D7 13
		 99 33 CC FF
		 07 10 00 00
		 66 01 33 47
		 3B 00 40 00
		 10 05 0A FA
		 FF 00 00 00
		 00 00 00 00
		 00 00 00 00
		 00 00 00 00
		 00 00 00 00
		 00 00 00 00
		 00 00 00 00
		 00 00 00 00
		 00 00 00 00
		 00 00 00 00
		 00 00 00 00
		 00 00 00 00
		 00 00 00 00
		 00 00 00 00
		 00 00 00 00
		 00 00 00 00
		 00 00 00 00
		 00 00 00 00
		 00 00 00 00
	];
};
